&i2c3 {
	status = "ok";
	goodix-berlin@5d {
		compatible = "goodix,gt9897";
		reg = <0x5d>;
		goodix,avdd-name = "avdd";
		avdd-supply = <&vddcama0>;
		goodix,iovdd-name = "iovdd";
		iovdd-supply = <&vddldo1>;
		goodix,power-on-delay-us = <800>;
		goodix,reset-gpio = <&ap_gpio 145 0x0>;
		goodix,irq-gpio = <&eic_async 0 0x2800>;
		goodix,irq-flags = <2>; /* 1:trigger rising, 2:trigger falling;*/
		goodix,panel-max-x = <1080>;
		goodix,panel-max-y = <2400>;
		goodix,panel-max-w = <255>;
	};
};

