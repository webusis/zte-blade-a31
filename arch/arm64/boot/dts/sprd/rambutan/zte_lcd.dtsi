
#include "zte_lcd_visionox_rm692e1_hbm51_6p67_amoled_fhd_cmd.dtsi"
#include "zte_lcd_dummy_mipi.dtsi"

&dphy {
	/delete-property/ sprd,ulps-disabled;
};

&panel {
	reset-gpio = <&ap_gpio 50 GPIO_ACTIVE_HIGH>;
	avdd-gpio = <&ap_gpio 96 GPIO_ACTIVE_HIGH>;
	power-supply = <&vddkpled>;
};
